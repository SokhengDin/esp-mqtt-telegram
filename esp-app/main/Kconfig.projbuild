## esp-app/main/Kconfig.projbuild
```kconfig
menu "ESP32 Device Controller Configuration"

    choice ESP32_CHIP_TYPE
        prompt "ESP32 Chip Type"
        default ESP32_CHIP_ESP32
        help
            Select your ESP32 chip type. This will automatically configure GPIO pins and other settings.

        config ESP32_CHIP_ESP32
            bool "ESP32"
            help
                Original ESP32 with 38 GPIO pins (0-39, excluding 6,7,8,9,10,11 which are used for flash)

        config ESP32_CHIP_ESP32C3
            bool "ESP32-C3"
            help
                ESP32-C3 RISC-V based chip with 22 GPIO pins (0-21)

        config ESP32_CHIP_ESP32C6
            bool "ESP32-C6" 
            help
                ESP32-C6 RISC-V based chip with 24 GPIO pins (0-23)

        config ESP32_CHIP_ESP32S2
            bool "ESP32-S2"
            help
                ESP32-S2 with 46 GPIO pins (0-45, excluding some used for flash/PSRAM)

        config ESP32_CHIP_ESP32S3
            bool "ESP32-S3"
            help
                ESP32-S3 with 48 GPIO pins (0-47, excluding some used for flash/PSRAM)
    endchoice

    config ESP_WIFI_SSID
        string "WiFi SSID"
        default "myssid"
        help
            SSID (network name) for the WiFi network to connect to.

    config ESP_WIFI_PASSWORD
        string "WiFi Password"
        default "mypassword"
        help
            WiFi password (WPA or WPA2) for the access point.

    config ESP_MAXIMUM_RETRY
        int "Maximum retry"
        default 5
        help
            Set the Maximum retry to avoid station reconnecting to the AP unlimited when the AP is really inexistent.

    config MQTT_BROKER_URI
        string "MQTT Broker URI"
        default "mqtt://localhost:1883"
        help
            URI of the MQTT broker to connect to.

    config MQTT_USERNAME
        string "MQTT Username"
        default ""
        help
            Username for MQTT broker authentication (leave empty if not required).

    config MQTT_PASSWORD
        string "MQTT Password"
        default ""
        help
            Password for MQTT broker authentication (leave empty if not required).

    config DEVICE_ID
        string "Device ID"
        default "esp-cdc-hrm-1"
        help
            Unique identifier for this ESP32 device.

    config RELAY_GPIO
        int "Relay GPIO Pin"
        default 2 if ESP32_CHIP_ESP32
        default 8 if ESP32_CHIP_ESP32C3
        default 8 if ESP32_CHIP_ESP32C6
        default 2 if ESP32_CHIP_ESP32S2
        default 2 if ESP32_CHIP_ESP32S3
        range 0 39 if ESP32_CHIP_ESP32
        range 0 21 if ESP32_CHIP_ESP32C3
        range 0 23 if ESP32_CHIP_ESP32C6
        range 0 45 if ESP32_CHIP_ESP32S2
        range 0 47 if ESP32_CHIP_ESP32S3
        help
            GPIO pin number connected to the relay control.
            ESP32: GPIO0-39 (avoid 6,7,8,9,10,11 - used for flash)
            ESP32-C3: GPIO0-21
            ESP32-C6: GPIO0-23
            ESP32-S2: GPIO0-45 (some pins used for flash/PSRAM)
            ESP32-S3: GPIO0-47 (some pins used for flash/PSRAM)

    config STATUS_LED_GPIO
        int "Status LED GPIO Pin"
        default 25 if ESP32_CHIP_ESP32
        default 15 if ESP32_CHIP_ESP32C3
        default 15 if ESP32_CHIP_ESP32C6
        default 25 if ESP32_CHIP_ESP32S2
        default 25 if ESP32_CHIP_ESP32S3
        range 0 39 if ESP32_CHIP_ESP32
        range 0 21 if ESP32_CHIP_ESP32C3
        range 0 23 if ESP32_CHIP_ESP32C6
        range 0 45 if ESP32_CHIP_ESP32S2
        range 0 47 if ESP32_CHIP_ESP32S3
        help
            GPIO pin number connected to the status LED.
            ESP32: GPIO0-39 (avoid 6,7,8,9,10,11 - used for flash)
            ESP32-C3: GPIO0-21
            ESP32-C6: GPIO0-23
            ESP32-S2: GPIO0-45 (some pins used for flash/PSRAM)
            ESP32-S3: GPIO0-47 (some pins used for flash/PSRAM)

endmenu 
```

## esp-app/sdkconfig.defaults
```kconfig
# ESP32-C6 Target Configuration
CONFIG_IDF_TARGET_ESP32C6=y
CONFIG_IDF_TARGET="esp32c6"

# WiFi Configuration
CONFIG_ESP_WIFI_SSID=""
CONFIG_ESP_WIFI_PASSWORD=""
CONFIG_ESP_MAXIMUM_RETRY=5

# MQTT Configuration
CONFIG_MQTT_BROKER_URI=""
CONFIG_MQTT_USERNAME=""
CONFIG_MQTT_PASSWORD=""

# FreeRTOS Configuration for ESP32-C6
CONFIG_FREERTOS_HZ=1000
CONFIG_FREERTOS_CHECK_STACKOVERFLOW_CANARY=y
CONFIG_FREERTOS_THREAD_LOCAL_STORAGE_POINTERS=1
CONFIG_FREERTOS_ASSERT_ON_UNTESTED_FUNCTION=y
CONFIG_FREERTOS_CHECK_STACKOVERFLOW=2
CONFIG_FREERTOS_USE_TRACE_FACILITY=y
CONFIG_FREERTOS_USE_TICKLESS_IDLE=y

# Main task stack size (larger for ESP32-C6)
CONFIG_ESP_MAIN_TASK_STACK_SIZE=8192

# Task watchdog configuration - increased timeout
CONFIG_ESP_TASK_WDT=y
CONFIG_ESP_TASK_WDT_PANIC=y
CONFIG_ESP_TASK_WDT_TIMEOUT_S=20
CONFIG_ESP_TASK_WDT_CHECK_IDLE_TASK_CPU0=y

# Heap configuration for ESP32-C6
CONFIG_HEAP_CORRUPTION_DETECTION=y
CONFIG_HEAP_TRACING_DEST_TRACING=y

# ESP32-C6 specific memory settings
CONFIG_ESP_SYSTEM_ALLOW_RTC_FAST_MEM_AS_HEAP=y

# WiFi for ESP32-C6
CONFIG_ESP_WIFI_AUTH_WPA2_PSK=y
CONFIG_ESP_WIFI_ENABLE_WPA3_SAE=y

# LWIP
CONFIG_LWIP_DHCP_DOES_ARP_CHECK=y

# Log output
CONFIG_LOG_DEFAULT_LEVEL_INFO=y
CONFIG_LOG_MAXIMUM_LEVEL_VERBOSE=y

# Partition Table
CONFIG_PARTITION_TABLE_SINGLE_APP_LARGE=y

# ESP32-C6 GPIO configuration
CONFIG_SOC_GPIO_VALID_GPIO_MASK=0x3FFFFF
CONFIG_SOC_GPIO_VALID_DIGITAL_IO_PAD_MASK=0x3FFFFF

# System configuration to prevent crashes
CONFIG_ESP_SYSTEM_PANIC_PRINT_HALT=y
CONFIG_ESP_SYSTEM_CHECK_INT_LEVEL_5=y

# Brownout Detector Configuration - Disable to prevent false triggers during PHY init
CONFIG_ESP_BROWNOUT_DET=n

# Power Management - More aggressive settings
CONFIG_ESP32_DEFAULT_CPU_FREQ_80=y
CONFIG_ESP32_DEFAULT_CPU_FREQ_MHZ=80

# PHY and RF Configuration - Reduce power consumption during initialization
CONFIG_ESP_PHY_REDUCE_TX_POWER=y
CONFIG_ESP_PHY_MAX_WIFI_TX_POWER=8
CONFIG_ESP_PHY_CALIBRATION_AND_DATA_STORAGE=y
CONFIG_ESP_PHY_INIT_DATA_IN_PARTITION=y
CONFIG_ESP_PHY_MAX_TX_POWER=8

# PHY Calibration optimization - avoid full calibration
CONFIG_ESP_PHY_RF_CAL_PARTIAL=y
CONFIG_ESP_PHY_CALIBRATION_MODE_PARTIAL=y

# Force minimal calibration mode
CONFIG_ESP_PHY_CALIBRATION_MODE=0

# Additional PHY power optimizations
CONFIG_ESP_PHY_ENABLE_USB=n
CONFIG_ESP_PHY_RF_CAL_NONE=y

# WiFi Power Management - More aggressive settings
CONFIG_ESP32_WIFI_IRAM_OPT=n
CONFIG_ESP32_WIFI_RX_IRAM_OPT=n
CONFIG_ESP32_WIFI_DYNAMIC_TX_BUFFER_NUM=8
CONFIG_ESP32_WIFI_STATIC_RX_BUFFER_NUM=2
CONFIG_ESP32_WIFI_DYNAMIC_RX_BUFFER_NUM=8
CONFIG_ESP_WIFI_SLP_IRAM_OPT=n

# Additional power optimizations for ESP32-C6
CONFIG_ESP_SLEEP_POWER_DOWN_FLASH=y

# Enable power management features
CONFIG_PM_ENABLE=y
CONFIG_PM_DFS_INIT_AUTO=y
CONFIG_PM_USE_RTC_TIMER_REF=y
CONFIG_ESP_PM_TRACE=y

# Reduce system clock during WiFi operations
CONFIG_ESP_DEFAULT_CPU_FREQ_MHZ_80=y

# Memory optimizations to reduce power
CONFIG_ESP_SYSTEM_ALLOW_RTC_FAST_MEM_AS_HEAP=y
CONFIG_SPIRAM_ALLOW_BSS_SEG_EXTERNAL_MEMORY=n

# Disable unnecessary features to save power
CONFIG_ESP_COREDUMP_ENABLE=n
CONFIG_ESP_ERR_TO_NAME_LOOKUP=n

# Power management component dependencies
CONFIG_ESP_TIMER_PROFILING=y
CONFIG_ESP_TIMER_TASK_STACK_SIZE=4096

# ESP32-C6 specific power management
CONFIG_ESP32C6_DEFAULT_CPU_FREQ_160=n
CONFIG_ESP32C6_DEFAULT_CPU_FREQ_80=y
CONFIG_ESP32C6_DEFAULT_CPU_FREQ_MHZ=80 
```
